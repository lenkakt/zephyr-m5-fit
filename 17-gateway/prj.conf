## CMakeLists.txt
```
# SPDX-License-Identifier: GPL-3.0-or-later
#
# Unlike every other example in this repo, this one links wolfMQTT
# (GPL-3.0-or-later) to get an MQTT broker - see README.md for why that
# makes this specific subdirectory GPL, not Apache-2.0 like the rest.

cmake_minimum_required(VERSION 3.20.0)

# wolfMQTT isn't a west-managed module here (this workspace's west
# manifest is shared with every other example and zephyr4squirrels) -
# fetch it locally instead; see README.md. Same "manual copy" escape
# hatch wolfMQTT's own Zephyr module docs describe for workspaces where
# west doesn't provide it.
if(EXISTS ${CMAKE_CURRENT_SOURCE_DIR}/deps/wolfmqtt)
  list(APPEND ZEPHYR_EXTRA_MODULES ${CMAKE_CURRENT_SOURCE_DIR}/deps/wolfmqtt)
endif()

set(DTC_OVERLAY_FILE ${CMAKE_CURRENT_SOURCE_DIR}/boards/m5stack_fire_esp32_procpu.overlay)

find_package(Zephyr REQUIRED HINTS $ENV{ZEPHYR_BASE})
project(gateway)

zephyr_compile_definitions(WOLFMQTT_USER_SETTINGS)

target_sources(app PRIVATE
	src/main.c
	src/wifi.c
	src/broker_net.c
	src/uplink.c
	src/client_net.c
)
target_include_directories(app PRIVATE src)
```

## Kconfig
```
# SPDX-License-Identifier: GPL-3.0-or-later
source "Kconfig.zephyr"

config APP_AP_SSID
	string "AP SSID for the sensor-side network this gateway hosts"
	default "fit-iot-gateway"
	depends on WIFI

config APP_AP_PSK
	string "AP password (empty = open network - fine for a classroom demo)"
	depends on WIFI

config APP_AP_IP_ADDRESS
	string "AP interface IP address"
	default "192.168.4.1"
	depends on WIFI

config APP_UPLINK_TOPIC_FILTER
	string "Topic filter the gateway's internal client subscribes to, on its own broker"
	default "+/sensor"
	depends on WOLFMQTT
```

## prj.conf
```kconfig
# SPDX-License-Identifier: GPL-3.0-or-later

CONFIG_LOG=y
CONFIG_SHELL=y

# Wi-Fi: AP (sensor side, enabled unconditionally at boot - see
# README.md "Why the AP side doesn't wait for anything") + STA (uplink,
# provisioned over the shell exactly like 07-wifi/08-http/15-mqtt).
CONFIG_NETWORKING=y
CONFIG_NET_L2_WIFI_SHELL=y
CONFIG_WIFI=y
CONFIG_WIFI_NM=y
CONFIG_WIFI_USAGE_MODE_STA_AP=y
CONFIG_NET_DHCPV4=y
CONFIG_NET_DHCPV4_SERVER=y
CONFIG_NET_IPV4=y
CONFIG_NET_IPV6=n
CONFIG_NET_IF_MAX_IPV4_COUNT=2
CONFIG_NET_MGMT_EVENT_QUEUE_SIZE=16

CONFIG_WIFI_CREDENTIALS=y
CONFIG_WIFI_CREDENTIALS_CONNECT_STORED=y
CONFIG_SETTINGS=y
CONFIG_SETTINGS_NVS=y
CONFIG_FLASH=y
CONFIG_FLASH_MAP=y
CONFIG_NVS=y

# MQTT broker (wolfMQTT) + the internal loopback client, both over
# plain POSIX sockets.
CONFIG_NET_SOCKETS=y
CONFIG_POSIX_API=y
CONFIG_NET_TCP=y
CONFIG_NET_BUF_DATA_SIZE=256
CONFIG_MAIN_STACK_SIZE=4096

# Broker's own listener + a couple of sensor clients + the loopback
# uplink client - see src/user_settings.h for the matching BROKER_MAX_*.
CONFIG_NET_MAX_CONTEXTS=6
CONFIG_NET_MAX_CONN=6
CONFIG_NET_PKT_RX_COUNT=16
CONFIG_NET_PKT_TX_COUNT=16
CONFIG_NET_BUF_RX_COUNT=32
CONFIG_NET_BUF_TX_COUNT=32

CONFIG_WOLFMQTT=y
CONFIG_WOLFMQTT_SETTINGS_FILE="user_settings.h"
```

## boards/m5stack_fire_esp32_procpu.overlay
```dts
/* SPDX-License-Identifier: GPL-3.0-or-later */
/*
 * Second Wi-Fi node so the ESP32 driver exposes an AP interface
 * alongside the STA one - needed for AP+STA concurrent mode. Same node
 * Zephyr's own samples/net/wifi/apsta_mode uses for esp32_procpu.
 */
/ {
	wifi_ap: wifi_ap {
		compatible = "espressif,esp32-wifi";
		status = "okay";
	};
};
```

## src/main.c
```c
/* SPDX-License-Identifier: GPL-3.0-or-later */
/*
 * Template for the final-assignment gateway: hosts the sensor node's
 * Wi-Fi network (AP), joins an internet-connected one (STA), and is
 * both an MQTT broker (for the sensor) and an MQTT client (its own
 * uplink thread, src/uplink.c) at once. See README.md for the full
 * picture and what's deliberately left out of this template.
 */
#include <zephyr/kernel.h>
#include <zephyr/net/net_if.h>
#include <zephyr/net/net_mgmt.h>
#include <zephyr/net/net_event.h>
#include <zephyr/net/wifi_mgmt.h>
#include <zephyr/logging/log.h>

#include "broker_net.h"
#include "wifi.h"
#include "uplink.h"

LOG_MODULE_REGISTER(main);

static MqttBroker broker;
static MqttBrokerNet net;

static struct net_mgmt_event_callback wifi_cb;
static struct net_mgmt_event_callback ipv4_cb;

static void event_handler(struct net_mgmt_event_callback *cb, uint64_t mgmt_event,
			   struct net_if *iface)
{
	if (mgmt_event == NET_EVENT_WIFI_CONNECT_RESULT) {
		LOG_INF("Uplink Wi-Fi connected");
	}
	if (mgmt_event == NET_EVENT_IPV4_ADDR_ADD) {
		LOG_INF("Uplink got an IPv4 address");
	}
}

int main(void)
{
	int rc;

	LOG_INF("MqttBroker uses %zu bytes of RAM", sizeof(broker));

	net_mgmt_init_event_callback(&wifi_cb, event_handler, NET_EVENT_WIFI_CONNECT_RESULT);
	net_mgmt_add_event_callback(&wifi_cb);
	net_mgmt_init_event_callback(&ipv4_cb, event_handler, NET_EVENT_IPV4_ADDR_ADD);
	net_mgmt_add_event_callback(&ipv4_cb);

	/* AP first - required for the ESP32 driver to settle into AP+STA
	 * combo mode rather than switching between the two - and it's
	 * unconditional: the sensor-facing network and the broker on it
	 * must come up with no dependency on the uplink even existing.
	 * That's the whole point of this design - see README.md.
	 */
	rc = wifi_ap_enable();
	if (rc != 0) {
		return rc;
	}

	/* Best-effort and non-blocking - connects in the background if a
	 * credential is stored, logs and moves on if not. Either way,
	 * nothing below this point depends on it.
	 */
	wifi_sta_connect();

	/* uplink_thread (src/uplink.c) is already running by now via its
	 * own K_THREAD_DEFINE, independently of everything here.
	 */

	broker_net_init(&net);

	rc = MqttBroker_Init(&broker, &net);
	if (rc != MQTT_CODE_SUCCESS) {
		LOG_ERR("Broker init failed: %d", rc);
		return rc;
	}

	rc = MqttBroker_Run(&broker);
	LOG_INF("Broker stopped: %d", rc);
	return rc;
}
```

## src/broker_net.c
```c
/* SPDX-License-Identifier: GPL-3.0-or-later */
/*
 * Zephyr/zsock glue for wolfMQTT's MqttBrokerNet callbacks - the
 * broker library calls these, it never touches sockets directly.
 */
#include <errno.h>
#include <string.h>
#include <zephyr/net/socket.h>

#include "broker_net.h"

static int net_listen(void *ctx, BROKER_SOCKET_T *sock, word16 port, int backlog)
{
	struct net_sockaddr_in addr = {0};
	int opt = 1;
	int fd = zsock_socket(NET_AF_INET, NET_SOCK_STREAM, NET_IPPROTO_TCP);

	ARG_UNUSED(ctx);

	if (fd < 0) {
		return MQTT_CODE_ERROR_NETWORK;
	}

	zsock_setsockopt(fd, ZSOCK_SOL_SOCKET, ZSOCK_SO_REUSEADDR, &opt, sizeof(opt));

	addr.sin_family = NET_AF_INET;
	addr.sin_port = net_htons(port);

	if (zsock_bind(fd, (struct net_sockaddr *)&addr, sizeof(addr)) < 0 ||
	    zsock_listen(fd, backlog) < 0) {
		zsock_close(fd);
		return MQTT_CODE_ERROR_NETWORK;
	}

	*sock = fd;
	return MQTT_CODE_SUCCESS;
}

static int wait_for(int fd, short events, int timeout_ms)
{
	struct zsock_pollfd pfd = {.fd = fd, .events = events};
	int rc = zsock_poll(&pfd, 1, timeout_ms);

	if (rc == 0) {
		return MQTT_CODE_ERROR_TIMEOUT;
	}
	return rc < 0 ? MQTT_CODE_ERROR_NETWORK : MQTT_CODE_SUCCESS;
}

static int net_accept(void *ctx, BROKER_SOCKET_T listen_sock, BROKER_SOCKET_T *client_sock)
{
	int fd;

	ARG_UNUSED(ctx);

	if (wait_for(listen_sock, ZSOCK_POLLIN, 5) != MQTT_CODE_SUCCESS) {
		return MQTT_CODE_CONTINUE;
	}

	fd = zsock_accept(listen_sock, NULL, NULL);
	if (fd < 0) {
		return MQTT_CODE_ERROR_NETWORK;
	}

	*client_sock = fd;
	return MQTT_CODE_SUCCESS;
}

static int transfer_result(int rc)
{
	if (rc > 0) {
		return rc;
	}
	if (rc < 0 && (errno == EAGAIN || errno == EWOULDBLOCK)) {
		return MQTT_CODE_CONTINUE;
	}
	return MQTT_CODE_ERROR_NETWORK;
}

static int net_read(void *ctx, BROKER_SOCKET_T sock, byte *buf, int buf_len, int timeout_ms)
{
	int rc;

	ARG_UNUSED(ctx);

	if (buf == NULL || buf_len <= 0) {
		return MQTT_CODE_ERROR_BAD_ARG;
	}
	if (timeout_ms > 0) {
		rc = wait_for(sock, ZSOCK_POLLIN, timeout_ms);
		if (rc != MQTT_CODE_SUCCESS) {
			return rc;
		}
	}
	return transfer_result(zsock_recv(sock, buf, buf_len, ZSOCK_MSG_DONTWAIT));
}

static int net_write(void *ctx, BROKER_SOCKET_T sock, const byte *buf, int buf_len, int timeout_ms)
{
	int rc;

	ARG_UNUSED(ctx);

	if (buf == NULL || buf_len <= 0) {
		return MQTT_CODE_ERROR_BAD_ARG;
	}
	if (timeout_ms > 0) {
		rc = wait_for(sock, ZSOCK_POLLOUT, timeout_ms);
		if (rc != MQTT_CODE_SUCCESS) {
			return rc;
		}
	}
	return transfer_result(zsock_send(sock, buf, buf_len, ZSOCK_MSG_DONTWAIT));
}

static int net_close(void *ctx, BROKER_SOCKET_T sock)
{
	ARG_UNUSED(ctx);

	if (sock != BROKER_SOCKET_INVALID) {
		zsock_close(sock);
	}
	return MQTT_CODE_SUCCESS;
}

void broker_net_init(MqttBrokerNet *net)
{
	memset(net, 0, sizeof(*net));
	net->listen = net_listen;
	net->accept = net_accept;
	net->read = net_read;
	net->write = net_write;
	net->close = net_close;
}
```

## src/client_net.c
```c
/* SPDX-License-Identifier: GPL-3.0-or-later */
#include <errno.h>
#include <string.h>
#include <zephyr/net/socket.h>

#include "client_net.h"

/* Always loopback (127.0.0.1) in this app - the gateway only ever uses
 * this to subscribe to its own, local broker - so no DNS/getaddrinfo
 * needed, just a fixed address.
 */

struct client_net_ctx {
	int fd;
};

static struct client_net_ctx ctx = {.fd = -1};

static int wait_for(int fd, short events, int timeout_ms)
{
	struct zsock_pollfd pfd = {.fd = fd, .events = events};
	int rc = zsock_poll(&pfd, 1, timeout_ms);

	if (rc == 0) {
		return MQTT_CODE_ERROR_TIMEOUT;
	}
	return rc < 0 ? MQTT_CODE_ERROR_NETWORK : MQTT_CODE_SUCCESS;
}

static int client_connect(void *context, const char *host, word16 port, int timeout_ms)
{
	struct client_net_ctx *c = context;
	struct net_sockaddr_in addr = {0};
	int fd = zsock_socket(NET_AF_INET, NET_SOCK_STREAM, NET_IPPROTO_TCP);

	ARG_UNUSED(timeout_ms);

	if (fd < 0) {
		return MQTT_CODE_ERROR_NETWORK;
	}

	addr.sin_family = NET_AF_INET;
	addr.sin_port = net_htons(port);
	if (zsock_inet_pton(NET_AF_INET, host, &addr.sin_addr) != 1) {
		zsock_close(fd);
		return MQTT_CODE_ERROR_NETWORK;
	}

	if (zsock_connect(fd, (struct net_sockaddr *)&addr, sizeof(addr)) < 0) {
		zsock_close(fd);
		return MQTT_CODE_ERROR_NETWORK;
	}

	c->fd = fd;
	return MQTT_CODE_SUCCESS;
}

static int client_read(void *context, byte *buf, int buf_len, int timeout_ms)
{
	struct client_net_ctx *c = context;
	int rc;

	if (timeout_ms > 0) {
		rc = wait_for(c->fd, ZSOCK_POLLIN, timeout_ms);
		if (rc != MQTT_CODE_SUCCESS) {
			return rc;
		}
	}

	rc = zsock_recv(c->fd, buf, buf_len, 0);
	if (rc == 0) {
		return MQTT_CODE_ERROR_NETWORK; /* broker closed the connection */
	}
	if (rc < 0) {
		return (errno == EAGAIN || errno == EWOULDBLOCK)
			       ? MQTT_CODE_ERROR_TIMEOUT
			       : MQTT_CODE_ERROR_NETWORK;
	}
	return rc;
}

static int client_write(void *context, const byte *buf, int buf_len, int timeout_ms)
{
	struct client_net_ctx *c = context;
	int rc;

	if (timeout_ms > 0) {
		rc = wait_for(c->fd, ZSOCK_POLLOUT, timeout_ms);
		if (rc != MQTT_CODE_SUCCESS) {
			return rc;
		}
	}

	rc = zsock_send(c->fd, buf, buf_len, 0);
	return rc < 0 ? MQTT_CODE_ERROR_NETWORK : rc;
}

static int client_disconnect(void *context)
{
	struct client_net_ctx *c = context;

	if (c->fd >= 0) {
		zsock_close(c->fd);
		c->fd = -1;
	}
	return MQTT_CODE_SUCCESS;
}

void client_net_init(MqttNet *net)
{
	memset(net, 0, sizeof(*net));
	net->context = &ctx;
	net->connect = client_connect;
	net->read = client_read;
	net->write = client_write;
	net->disconnect = client_disconnect;
}
```

## src/client_net.h
```c
/* SPDX-License-Identifier: GPL-3.0-or-later */
#ifndef CLIENT_NET_H
#define CLIENT_NET_H

#include "wolfmqtt/mqtt_client.h"

/* Zephyr/zsock glue for wolfMQTT's *client* API (MqttNet) - the
 * counterpart to broker_net.c, which does the same for the broker's
 * own MqttBrokerNet. Two different callback structs in the library,
 * so two small glue files, same socket primitives underneath.
 */
void client_net_init(MqttNet *net);

#endif
```

## src/uplink.c
```c
/* SPDX-License-Identifier: GPL-3.0-or-later */
/*
 * The broker library has no app-level "notify me when something is
 * published" hook, so this is what "the broker also subscribes" has
 * to mean in practice: an ordinary wolfMQTT *client*, in its own
 * thread, connecting to this same device's broker over loopback
 * exactly like any remote subscriber would.
 *
 * This is the template, not the full solution: it only logs what it
 * receives. Forwarding those readings to InfluxDB/Grafana over the
 * STA/uplink Wi-Fi leg - the actual "connects to the internet" job -
 * is deliberately left out; that's where the real solution's logic
 * goes, in forward_reading() below.
 */
#include <zephyr/kernel.h>
#include <zephyr/sys/printk.h>

#include "wolfmqtt/mqtt_client.h"
#include "client_net.h"
#include "uplink.h"

#define BROKER_HOST    "127.0.0.1"
#define BROKER_PORT    1883
#define CLIENT_ID      "gateway-uplink"
#define CMD_TIMEOUT_MS 5000
#define KEEP_ALIVE_SEC 60

static MqttClient client;
static MqttNet net;
static byte tx_buf[256];
static byte rx_buf[256];

static void forward_reading(const char *topic, const byte *payload, word32 payload_len)
{
	/* The full solution forwards this to InfluxDB/Grafana over the
	 * STA/uplink interface here. This template just proves the
	 * mechanism: the gateway received, on its own broker, something
	 * a sensor node published to it.
	 */
	printk("uplink: received on '%s': %.*s\n", topic, (int)payload_len, payload);
}

static int msg_cb(MqttClient *c, MqttMessage *msg, byte msg_new, byte msg_done)
{
	ARG_UNUSED(c);

	/* Sensor payloads are tiny - always one chunk. */
	if (msg_new && msg_done) {
		forward_reading(msg->topic_name, msg->buffer, msg->buffer_len);
	}
	return MQTT_CODE_SUCCESS;
}

static int uplink_connect_once(void)
{
	MqttConnect mc = {0};
	MqttSubscribe sub = {0};
	MqttTopic topic = {0};
	int rc;

	client_net_init(&net);

	rc = MqttClient_Init(&client, &net, msg_cb, tx_buf, sizeof(tx_buf), rx_buf,
			      sizeof(rx_buf), CMD_TIMEOUT_MS);
	if (rc != MQTT_CODE_SUCCESS) {
		return rc;
	}

	rc = MqttClient_NetConnect(&client, BROKER_HOST, BROKER_PORT, CMD_TIMEOUT_MS, 0, NULL);
	if (rc != MQTT_CODE_SUCCESS) {
		return rc;
	}

	mc.keep_alive_sec = KEEP_ALIVE_SEC;
	mc.clean_session = 1;
	mc.client_id = CLIENT_ID;
	rc = MqttClient_Connect(&client, &mc);
	if (rc != MQTT_CODE_SUCCESS) {
		return rc;
	}

	topic.topic_filter = CONFIG_APP_UPLINK_TOPIC_FILTER;
	topic.qos = MQTT_QOS_0;
	sub.topic_count = 1;
	sub.topics = &topic;
	rc = MqttClient_Subscribe(&client, &sub);
	if (rc != MQTT_CODE_SUCCESS) {
		return rc;
	}

	printk("uplink: subscribed to '%s' on our own broker\n",
	       CONFIG_APP_UPLINK_TOPIC_FILTER);
	return MQTT_CODE_SUCCESS;
}

static void uplink_thread(void *p1, void *p2, void *p3)
{
	int64_t next_ping;

	ARG_UNUSED(p1);
	ARG_UNUSED(p2);
	ARG_UNUSED(p3);

	/* The broker (main.c, src/broker_net.c) runs on main's thread.
	 * It may not be listening in the first instant - retry the
	 * connect rather than trying to synchronize on it directly.
	 */
	while (uplink_connect_once() != MQTT_CODE_SUCCESS) {
		printk("uplink: broker not ready yet, retrying\n");
		k_sleep(K_SECONDS(2));
	}

	next_ping = k_uptime_get() + (KEEP_ALIVE_SEC / 2) * MSEC_PER_SEC;

	while (true) {
		int rc = MqttClient_WaitMessage(&client, 1000);

		if (rc != MQTT_CODE_SUCCESS && rc != MQTT_CODE_ERROR_TIMEOUT) {
			printk("uplink: connection lost (%d), reconnecting\n", rc);
			MqttClient_NetDisconnect(&client);
			while (uplink_connect_once() != MQTT_CODE_SUCCESS) {
				k_sleep(K_SECONDS(2));
			}
			next_ping = k_uptime_get() + (KEEP_ALIVE_SEC / 2) * MSEC_PER_SEC;
			continue;
		}

		if (k_uptime_get() >= next_ping) {
			MqttClient_Ping(&client);
			next_ping = k_uptime_get() + (KEEP_ALIVE_SEC / 2) * MSEC_PER_SEC;
		}
	}
}

K_THREAD_DEFINE(uplink_tid, 4096, uplink_thread, NULL, NULL, NULL, 7, 0, 0);
```

## src/uplink.h
```c
/* SPDX-License-Identifier: GPL-3.0-or-later */
#ifndef UPLINK_H
#define UPLINK_H

/* No functions to call - uplink_thread starts on its own via
 * K_THREAD_DEFINE in uplink.c. This header exists so main.c doesn't
 * need to know anything about it beyond "it's compiled in".
 */

#endif
```

## src/user_settings.h
```c
/* SPDX-License-Identifier: GPL-3.0-or-later */
#ifndef USER_SETTINGS_H
#define USER_SETTINGS_H

#include <zephyr/kernel.h>

#define NO_MAIN_DRIVER
#define WOLFMQTT_BROKER
#define WOLFMQTT_BROKER_CUSTOM_NET
#define WOLFMQTT_STATIC_MEMORY
#define WOLFMQTT_V5

#define WOLFMQTT_BROKER_GET_TIME_S() ((unsigned long)(k_uptime_get() / 1000))
#define BROKER_SLEEP_MS(ms) k_msleep(ms)

/* Small on purpose - a template for a classroom demo, not a
 * production broker. One sensor node plus this app's own loopback
 * uplink client is the expected load.
 */
#define BROKER_MAX_CLIENTS 4
#define BROKER_MAX_SUBS 8
#define BROKER_RX_BUF_SZ 512
#define BROKER_TX_BUF_SZ 512
#define BROKER_MAX_RETAINED 4
#define BROKER_MAX_PAYLOAD_LEN 256
#define BROKER_MAX_CLIENT_ID_LEN 32
#define BROKER_MAX_USERNAME_LEN 32
#define BROKER_MAX_PASSWORD_LEN 32
#define BROKER_MAX_FILTER_LEN 64
#define BROKER_MAX_TOPIC_LEN 64
#define BROKER_MAX_WILL_PAYLOAD_LEN 128
#define BROKER_MAX_STATIC_OFFLINE_MSGS_PER_SUB 4
#define BROKER_MAX_STATIC_OFFLINE_DATA_LEN 128

#endif
```

## src/wifi.c
```c
/* SPDX-License-Identifier: GPL-3.0-or-later */
#include <string.h>
#include <zephyr/kernel.h>
#include <zephyr/net/net_if.h>
#include <zephyr/net/net_ip.h>
#include <zephyr/net/net_mgmt.h>
#include <zephyr/net/wifi_mgmt.h>
#include <zephyr/net/wifi_credentials.h>
#include <zephyr/net/dhcpv4_server.h>
#include <zephyr/logging/log.h>

#include "wifi.h"

LOG_MODULE_REGISTER(wifi_gw);

int wifi_ap_enable(void)
{
	struct net_if *ap_iface = net_if_get_wifi_sap();
	struct wifi_connect_req_params ap_config = {0};
	struct net_in_addr addr, netmask;
	int rc;

	if (ap_iface == NULL) {
		LOG_ERR("No Wi-Fi AP interface (check the devicetree overlay)");
		return -ENODEV;
	}

	ap_config.ssid = (const uint8_t *)CONFIG_APP_AP_SSID;
	ap_config.ssid_length = strlen(CONFIG_APP_AP_SSID);
	ap_config.psk = (const uint8_t *)CONFIG_APP_AP_PSK;
	ap_config.psk_length = strlen(CONFIG_APP_AP_PSK);
	ap_config.security = strlen(CONFIG_APP_AP_PSK) > 0 ? WIFI_SECURITY_TYPE_PSK
							    : WIFI_SECURITY_TYPE_NONE;
	ap_config.channel = WIFI_CHANNEL_ANY;
	ap_config.band = WIFI_FREQ_BAND_2_4_GHZ;

	/* Static IP + DHCP pool for the sensor node joining the AP, same
	 * approach as Zephyr's samples/net/wifi/apsta_mode.
	 */
	net_addr_pton(NET_AF_INET, CONFIG_APP_AP_IP_ADDRESS, &addr);
	net_addr_pton(NET_AF_INET, "255.255.255.0", &netmask);
	net_if_ipv4_set_gw(ap_iface, &addr);
	net_if_ipv4_addr_add(ap_iface, &addr, NET_ADDR_MANUAL, 0);
	net_if_ipv4_set_netmask_by_addr(ap_iface, &addr, &netmask);

	addr.s4_addr[3] += 10; /* pool starts 10 above the AP's own address */
	rc = net_dhcpv4_server_start(ap_iface, &addr);
	if (rc != 0) {
		LOG_ERR("DHCPv4 server start failed: %d", rc);
		return rc;
	}

	rc = net_mgmt(NET_REQUEST_WIFI_AP_ENABLE, ap_iface, &ap_config, sizeof(ap_config));
	if (rc != 0) {
		LOG_ERR("AP enable failed: %d", rc);
		return rc;
	}

	LOG_INF("AP up: %s on %s", CONFIG_APP_AP_SSID, CONFIG_APP_AP_IP_ADDRESS);
	return 0;
}

static void count_ssid(void *cb_arg, const char *ssid, size_t ssid_len)
{
	size_t *count = cb_arg;

	(*count)++;
}

int wifi_sta_connect(void)
{
	struct net_if *sta_iface = net_if_get_wifi_sta();
	size_t cred_count = 0;

	if (sta_iface == NULL) {
		LOG_ERR("No Wi-Fi STA interface found");
		return -ENODEV;
	}

	wifi_credentials_for_each_ssid(count_ssid, &cred_count);
	if (cred_count == 0) {
		LOG_WRN("No stored uplink Wi-Fi credential - the AP/broker side still "
			"works without it. Provision one over the shell when you want "
			"the uplink too:");
		LOG_INF("  wifi cred add -s \"<SSID>\" -k 1 -p \"<password>\"");
		return 0;
	}

	int rc = net_mgmt(NET_REQUEST_WIFI_CONNECT_STORED, sta_iface, NULL, 0);

	if (rc != 0) {
		LOG_ERR("Uplink connect failed: %d", rc);
	}
	return rc;
}
```

## src/wifi.h
```c
/* SPDX-License-Identifier: GPL-3.0-or-later */
#ifndef WIFI_H
#define WIFI_H

/* Enables the AP (sensor-side network) unconditionally - doesn't wait
 * on anything, doesn't need a stored credential. See README.md "Why
 * the AP side doesn't wait for anything".
 */
int wifi_ap_enable(void);

/* Starts the STA (uplink) connect using whatever credential was
 * provisioned over the shell with `wifi cred add` - same as
 * 07-wifi/08-http/15-mqtt. Non-blocking: the result arrives later via
 * net_mgmt events (see main.c), same as those examples.
 */
int wifi_sta_connect(void);

#endif
```
