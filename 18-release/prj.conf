## CMakeLists.txt
```
# Copyright (c) 2026 Lenka Koskova Triskova
#
# SPDX-License-Identifier: Apache-2.0
# https://www.apache.org/licenses/LICENSE-2.0

cmake_minimum_required(VERSION 3.20.0)

# Pulled in unconditionally, merged on top of whichever of
# prj.conf/prj_release.conf FILE_SUFFIX selects for CONF_FILE -
# EXTRA_CONF_FILE is never subject to the suffix replace-not-merge
# behavior CONF_FILE has, so this is where the lines shared between
# the dev and release builds live, instead of being duplicated in
# both.
set(EXTRA_CONF_FILE common.conf)

find_package(Zephyr REQUIRED HINTS $ENV{ZEPHYR_BASE})
project(release)

target_sources(app PRIVATE src/main.c)
```

## prj.conf
```kconfig
# Copyright (c) 2026 Lenka Koskova Triskova
#
# SPDX-License-Identifier: Apache-2.0
# https://www.apache.org/licenses/LICENSE-2.0
#
# Development build - everything shared with the release build lives
# in common.conf (pulled in via EXTRA_CONF_FILE). Only the dev-only
# bits live here: the shell, needed to provision the serial number
# over `settings write` on the line.

CONFIG_SHELL=y
CONFIG_SETTINGS_SHELL=y
```

## common.conf
```kconfig
# Copyright (c) 2026 Lenka Koskova Triskova
#
# SPDX-License-Identifier: Apache-2.0
# https://www.apache.org/licenses/LICENSE-2.0
#
# Shared between the dev and release builds - pulled in via
# EXTRA_CONF_FILE (see CMakeLists.txt), which merges on top of
# whichever of prj.conf/prj_release.conf FILE_SUFFIX selects, rather
# than being replaced by it the way CONF_FILE itself would be.

CONFIG_LOG=y
CONFIG_HWINFO=y

# Settings subsystem, NVS-backed - the same mechanism 07-wifi's
# wifi_credentials already uses on this board (see 07-wifi/prj.conf
# for why each line below is needed individually). Here it stores an
# assigned serial number instead, under its own "device/" key
# namespace - the two coexist in the same storage partition without
# conflict, since Settings is a key-value store, not a single slot.
CONFIG_SETTINGS=y
CONFIG_SETTINGS_NVS=y
CONFIG_FLASH=y
CONFIG_FLASH_MAP=y
CONFIG_NVS=y
```

## prj_release.conf
```kconfig
# Copyright (c) 2026 Lenka Koskova Triskova
#
# SPDX-License-Identifier: Apache-2.0
# https://www.apache.org/licenses/LICENSE-2.0
#
# Release build - selected via FILE_SUFFIX=release, which replaces
# prj.conf with this file for CONF_FILE (not a merge - see
# CMakeLists.txt's comment on EXTRA_CONF_FILE for how the shared
# config in common.conf still reaches this build anyway).
#
# Build with: west build ... -- -DFILE_SUFFIX=release
#
# Nothing to turn on here - CONFIG_SHELL defaults to n, and
# CONFIG_SETTINGS_SHELL depends on it, so leaving both unset already
# means "no shell" (no provisioning, no unsigned access) in this
# build. Listed explicitly anyway so the intent reads as deliberate,
# not incidental - this is what actually changes for production.
CONFIG_SHELL=n
CONFIG_SETTINGS_SHELL=n

# FOLLOWING SHALL NEVER BE SWITCHED ON AT A SHARED LAB MACHINE!!!
# A real product's release config also adds, at this point:
#   CONFIG_BOOTLOADER_MCUBOOT=y, signed with a real production key
#   (instead of the debug/test key used during development), and
#   CONFIG_ESP_FLASH_ENCRYPTION=y. Both are covered conceptually in
# the security talk and deliberately not built here - the first
# makes an irreversible eFuse change, not something to run on shared
# lab hardware.
```

## src/main.c
```c
/* Copyright (c) 2026 Lenka Koskova Triskova
 *
 * SPDX-License-Identifier: Apache-2.0
 * https://www.apache.org/licenses/LICENSE-2.0
 */

#include <zephyr/kernel.h>
#include <zephyr/drivers/hwinfo.h>
#include <zephyr/settings/settings.h>
#include <zephyr/sys/util.h>
#include <zephyr/logging/log.h>

LOG_MODULE_REGISTER(main);

#define SERIAL_KEY "device/serial"

struct serial_result {
	char buf[32];
	bool found;
};

/* Mirrors settings_shell.c's own cmd_read callback: accept only an
 * exact match for SERIAL_KEY, not a descendant key.
 */
static int serial_load_cb(const char *key, size_t len, settings_read_cb read_cb,
			   void *cb_arg, void *param)
{
	struct serial_result *result = param;
	ssize_t n;

	if (settings_name_next(key, NULL) != 0) {
		return 0;
	}

	n = read_cb(cb_arg, result->buf, MIN(len, sizeof(result->buf) - 1));
	if (n > 0) {
		result->buf[n] = '\0';
		result->found = true;
	}

	return 0;
}

int main(void)
{
	uint8_t id[16];
	ssize_t id_len;
	struct serial_result serial = { .found = false };

	/* Fixed in silicon at manufacturing - readable, never assignable. */
	id_len = hwinfo_get_device_id(id, sizeof(id));
	if (id_len > 0) {
		LOG_HEXDUMP_INF(id, id_len,
				"silicon device ID (fixed in hardware, not assignable)");
	} else {
		LOG_WRN("hwinfo_get_device_id failed: %d", (int)id_len);
	}

	/* Assigned once, separately from flashing this firmware - over
	 * the shell, on the line that completes the device.
	 */
	settings_subsys_init();
	settings_load_subtree_direct(SERIAL_KEY, serial_load_cb, &serial);

	if (serial.found) {
		LOG_INF("assigned serial number: %s", serial.buf);
	} else {
		LOG_WRN("no serial number provisioned yet - over the shell, run:");
		LOG_WRN("  settings write string %s \"SN-00042\"", SERIAL_KEY);
		LOG_WRN("then reset the board");
	}

	return 0;
}
```
